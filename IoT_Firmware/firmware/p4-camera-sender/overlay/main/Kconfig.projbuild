## IoT_Firmware/firmware/p4-camera-sender/overlay/main/Kconfig.projbuild
```kconfig
menu "P4 Camera Sender"

    config EXAMPLE_M2M_MODE_ENCODE
        bool
        default y

    config EXAMPLE_M2M_MODE_DECODE
        bool
        default n

    config EXAMPLE_M2M_MODE_PIPELINE
        bool
        default n

    config EXAMPLE_H264_I_PERIOD
        int
        default 15

    config EXAMPLE_H264_BITRATE
        int
        default 1000000

    config EXAMPLE_H264_MIN_QP
        int
        default 25

    config EXAMPLE_H264_MAX_QP
        int
        default 35

    config P4SENDER_WIDTH
        int "Output width"
        default 1280
        range 160 1920

    config P4SENDER_HEIGHT
        int "Output height"
        default 960
        range 120 1080

    config P4SENDER_FPS
        int "Output frames per second"
        default 15
        range 1 30
    config P4SENDER_JPEG_QUALITY
        int "JPEG quality percent"
        default 50
        range 1 100

    config P4SENDER_SNAPSHOT_INTERVAL_MS
        int "Snapshot start interval in milliseconds"
        default 1700
        range 500 60000

    config P4SENDER_H264_BITRATE
        int "H.264 target bitrate (bps)"
        default 240000
        range 100000 1500000

    config P4SENDER_H264_GOP
        int "H.264 keyframe interval (frames)"
        default 15
        range 1 120

    config P4SENDER_H264_MIN_QP
        int "H.264 minimum QP"
        default 25
        range 1 51

    config P4SENDER_H264_MAX_QP
        int "H.264 maximum QP"
        default 35
        range 1 51

    config P4SENDER_UART_PORT
        int "UART port"
        default 1
        range 0 4

    config P4SENDER_UART_TX_GPIO
        int "UART TX GPIO connected to DT-06 RXD"
        default 32
        range 0 54

    config P4SENDER_UART_RX_GPIO
        int "UART RX GPIO (optional control channel)"
        default 33
        range -1 54

    config P4SENDER_UART_BAUD
        int "UART baud rate"
        default 1000000
        range 115200 4000000

    config P4SENDER_OLED_SDA_GPIO
        int "SSD1306 OLED SDA GPIO"
        default 28
        range 0 54

    config P4SENDER_OLED_SCL_GPIO
        int "SSD1306 OLED SCL GPIO"
        default 29
        range 0 54

    config P4SENDER_SPEAKER_GPIO
        int "Speaker PWM GPIO"
        default 30
        range 0 54

    config P4SENDER_DT06_STATE_GPIO
        int "DT-06 STATE GPIO"
        default 31
        range 0 54

endmenu
```

## IoT_Firmware/firmware/p4-camera-sender/overlay/sdkconfig.defaults
```kconfig
CONFIG_IDF_TARGET="esp32p4"
CONFIG_ESP32P4_SELECTS_REV_LESS_V3=y
CONFIG_ESP32P4_REV_MIN_100=y

CONFIG_EXAMPLE_SELECT_CUSTOMIZED_DEV_BOARD=y
CONFIG_EXAMPLE_MIPI_CSI_SCCB_I2C_SCL_PIN=8
CONFIG_EXAMPLE_MIPI_CSI_SCCB_I2C_SDA_PIN=7
CONFIG_EXAMPLE_ENABLE_MIPI_CSI_CAM_SENSOR=y
CONFIG_EXAMPLE_ENABLE_DVP_CAM_SENSOR=n
CONFIG_EXAMPLE_ENABLE_USB_UVC_CAM_SENSOR=n

CONFIG_CAMERA_OV5647=y
CONFIG_CAMERA_OV5647_AUTO_DETECT_MIPI_INTERFACE_SENSOR=y
CONFIG_CAMERA_OV5647_MIPI_RAW8_800X800_50FPS=n
CONFIG_CAMERA_OV5647_MIPI_RAW10_1280X960_BINNING_45FPS=y
CONFIG_CAMERA_OV5647_MIPI_DEFAULT_FMT_RAW8_800X800_50FPS=n
CONFIG_CAMERA_OV5647_MIPI_DEFAULT_FMT_RAW10_1280X960_BINNING_45FPS=y
CONFIG_CAMERA_OV5647_CSI_LINESYNC_ENABLE=y
CONFIG_CAMERA_SC2336=y
CONFIG_CAMERA_SC2336_AUTO_DETECT_MIPI_INTERFACE_SENSOR=y

CONFIG_ESP_VIDEO_ENABLE_MIPI_CSI_VIDEO_DEVICE=y
CONFIG_ESP_VIDEO_ENABLE_H264_VIDEO_DEVICE=n
CONFIG_ESP_VIDEO_ENABLE_HW_H264_VIDEO_DEVICE=n
CONFIG_ESP_VIDEO_ENABLE_JPEG_ENC_VIDEO_DEVICE=y
CONFIG_ESP_VIDEO_ENABLE_HW_JPEG_ENC_VIDEO_DEVICE=y
CONFIG_ESP_VIDEO_ENABLE_HW_JPEG_DEC_VIDEO_DEVICE=n
CONFIG_ESP_VIDEO_ENABLE_USB_UVC_VIDEO_DEVICE=n

CONFIG_EXAMPLE_M2M_MODE_ENCODE=y
CONFIG_P4SENDER_WIDTH=1280
CONFIG_P4SENDER_HEIGHT=960
CONFIG_P4SENDER_FPS=15
CONFIG_P4SENDER_JPEG_QUALITY=35
CONFIG_P4SENDER_SNAPSHOT_INTERVAL_MS=1700
CONFIG_P4SENDER_H264_BITRATE=240000
CONFIG_P4SENDER_H264_GOP=15
CONFIG_P4SENDER_H264_MIN_QP=25
CONFIG_P4SENDER_H264_MAX_QP=35
CONFIG_P4SENDER_UART_PORT=1
CONFIG_P4SENDER_UART_TX_GPIO=32
CONFIG_P4SENDER_UART_RX_GPIO=33
CONFIG_P4SENDER_UART_BAUD=1000000
CONFIG_P4SENDER_OLED_SDA_GPIO=28
CONFIG_P4SENDER_OLED_SCL_GPIO=29
CONFIG_P4SENDER_SPEAKER_GPIO=30
CONFIG_P4SENDER_DT06_STATE_GPIO=31

CONFIG_SPIRAM=y
CONFIG_ESPTOOLPY_FLASHSIZE_16MB=y
CONFIG_ESP_MAIN_TASK_STACK_SIZE=8192
CONFIG_VFS_MAX_COUNT=12
```

## IoT_Firmware/firmware/p4-usb-uvc-test/sdkconfig.defaults
```kconfig
CONFIG_IDF_TARGET="esp32p4"
CONFIG_ESP32P4_SELECTS_REV_LESS_V3=y
CONFIG_ESP32P4_REV_MIN_100=y

CONFIG_EXAMPLE_SELECT_CUSTOMIZED_DEV_BOARD=y
CONFIG_EXAMPLE_ENABLE_MIPI_CSI_CAM_SENSOR=y
CONFIG_EXAMPLE_ENABLE_DVP_CAM_SENSOR=n
CONFIG_EXAMPLE_ENABLE_USB_UVC_CAM_SENSOR=n
CONFIG_EXAMPLE_MIPI_CSI_SCCB_I2C_SCL_PIN=8
CONFIG_EXAMPLE_MIPI_CSI_SCCB_I2C_SDA_PIN=7

CONFIG_CAMERA_OV5647=y
CONFIG_CAMERA_OV5647_AUTO_DETECT_MIPI_INTERFACE_SENSOR=y
CONFIG_CAMERA_OV5647_MIPI_RAW10_1280X960_BINNING_45FPS=y
CONFIG_CAMERA_OV5647_MIPI_DEFAULT_FMT_RAW10_1280X960_BINNING_45FPS=y
CONFIG_CAMERA_OV5647_CSI_LINESYNC_ENABLE=y
CONFIG_CAMERA_OV5647_DEFAULT_IPA_JSON_CONFIGURATION_FILE=y

CONFIG_ESP_VIDEO_ENABLE_MIPI_CSI_VIDEO_DEVICE=y
CONFIG_ESP_VIDEO_ENABLE_H264_VIDEO_DEVICE=y
CONFIG_ESP_VIDEO_ENABLE_HW_H264_VIDEO_DEVICE=y
CONFIG_ESP_VIDEO_ENABLE_ISP_PIPELINE_CONTROLLER=y

CONFIG_FORMAT_H264_CAM1=y
CONFIG_UVC_CAM1_FRAMERATE=30
CONFIG_UVC_CAM1_FRAMESIZE_WIDTH=1280
CONFIG_UVC_CAM1_FRAMESIZE_HEIGT=960
CONFIG_UVC_CAM1_MULTI_FRAMESIZE=n
CONFIG_EXAMPLE_H264_I_PERIOD=30
CONFIG_EXAMPLE_H264_BITRATE=2500000
CONFIG_EXAMPLE_H264_MIN_QP=20
CONFIG_EXAMPLE_H264_MAX_QP=35

CONFIG_IDF_EXPERIMENTAL_FEATURES=y
CONFIG_SPIRAM=y
CONFIG_SPIRAM_SPEED_200M=y
CONFIG_ESPTOOLPY_FLASHSIZE_16MB=y
```
